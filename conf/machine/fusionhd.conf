## conf/machine/fusionhd.conf
```bitbake
#@TYPE: Machine
#@NAME: fusionhd
#@DESCRIPTION: Machine configuration for the Xsarius fusionhd

SOC_FAMILY = "bcm7362"
CHIPSET = "bcm7362"

BRAND_OEM = "dags"
MACHINE_BRAND = "XSARIUS"
MACHINE_NAME = "FUSION HD"

FRIENDLY_FAMILY = "dags7362"
STB_PLATFORM = "dags7362"
MACHINE_MODEL = "dags7362"

KERNEL_FILE = "oe_kernel.bin"
ROOTFS_FILE = "oe_rootfs.bin"
MTD_KERNEL = "mtd2"
MTD_ROOTFS = "mtd0"

MACHINE_FEATURES += " HDMI ci textlcd skins1080 TIMERWAKEUP"

IMAGEDIR ?= "update/fusionhd/cfe"

require conf/machine/include/xsarius.inc
```

## conf/machine/fusionhdse.conf
```bitbake
#@TYPE: Machine
#@NAME: fusionhdse
#@DESCRIPTION: Machine configuration for the Xsarius fusionhd

SOC_FAMILY = "bcm7362"
CHIPSET = "bcm7362"

BRAND_OEM = "dags"
MACHINE_BRAND = "XSARIUS"
MACHINE_NAME = "FUSION HD SE"

KERNEL_FILE = "oe_kernel.bin"
ROOTFS_FILE = "oe_rootfs.bin"
MTD_KERNEL = "mtd2"
MTD_ROOTFS = "mtd0"

MACHINE_FEATURES += " HDMI textlcd blindscan-dvbs skins1080 TIMERWAKEUP"

IMAGEDIR ?= "update/fusionhdse/cfe"

require conf/machine/include/xsarius.inc
```

## conf/machine/include/xsarius.inc
```bitbake
# We know about rtc
MACHINE_FEATURES_BACKFILL_CONSIDERED = "rtc"

include conf/machine/include/autoload-filesystems.inc

MACHINE_ESSENTIAL_EXTRA_RDEPENDS = " \
	xsarius-dvb-modules-${MACHINE} \
	xsarius-kernel-params \
	xsarius-shutdown \
	ntfs-3g \
"

KERNEL_MODULE_AUTOLOAD += "xfs"

MACHINE_EXTRA_RRECOMMENDS = " \
	gstreamer1.0-plugin-dvbmediasink \
	gstreamer1.0-libav \
	splash-bootlogo \
	xsarius-opera-dumpait \
	bcm \
"

EXTRA_IMAGEDEPENDS = " \
	splash-bootlogo \
"

TARGET_ARCH = "mipsel"
DEFAULTTUNE = "mips32el"

DVBMEDIASINK_CONFIG = "--with-wmv --with-pcm --with-eac3 --with-h265"

PREFERRED_PROVIDER_virtual/kernel = "linux-xsarius"
PREFERRED_VERSION_linux-xsarius = "4.2.1"

IMAGE_FSTYPES ?= "ubi"

UBI_VOLNAME = "rootfs"
MKUBIFS_ARGS = "-m 2048 -e 126976 -c 4096 -F"
UBINIZE_ARGS = "-m 2048 -p 128KiB"

EXTRA_IMAGECMD_COMPAT = " --eraseblock=0x20000 -n -l --pagesize=0x800 "

UBI_IMAGEDIR = "${WORKDIR}/deploy-${PN}-image-complete"

IMAGE_CMD:ubifs:prepend = " \
	mkdir -p ${IMAGE_ROOTFS}/usr/lib; \
	if [ "${PACKAGE_LIST}" = "1" ]; then \
	cp ${IMAGE_MANIFEST} ${IMAGE_ROOTFS}/usr/lib/package.lst; \
	fi; \
	rm -Rf ${IMAGE_ROOTFS}/boot/*; \
	rm -Rf ${IMAGE_ROOTFS}/tmp/*; \
	"

IMAGE_CMD:ubi:append = " \
	mkdir -p ${DEPLOY_DIR_IMAGE}/${IMAGEDIR}; \
	cp -f ${DEPLOY_DIR_IMAGE}/${MACHINE}_splash.bmp ${DEPLOY_DIR_IMAGE}/${IMAGEDIR}/splash.bmp; \
	cp -f ${DEPLOY_DIR_IMAGE}/${MACHINE}_splash1.bmp ${DEPLOY_DIR_IMAGE}/${IMAGEDIR}/splash1.bmp; \
	cp -f ${DEPLOY_DIR_IMAGE}/${MACHINE}_splash2.bmp ${DEPLOY_DIR_IMAGE}/${IMAGEDIR}/splash2.bmp; \
	mv ${IMGDEPLOYDIR}/${IMAGE_NAME}.ubi ${DEPLOY_DIR_IMAGE}/${IMAGEDIR}/${ROOTFS_FILE}; \
	gzip -f -9c ${DEPLOY_DIR_IMAGE}/vmlinux-${MACHINE}.bin > ${DEPLOY_DIR_IMAGE}/${IMAGEDIR}/${KERNEL_FILE}; \
	echo ${IMAGE_VER_STRING} > ${DEPLOY_DIR_IMAGE}/${IMAGEDIR}/imageversion; \
	cd ${DEPLOY_DIR_IMAGE}; \
	zip ${IMAGE_NAME}_usb.zip ${IMAGEDIR}/*; \
	rm -f ${DEPLOY_DIR_IMAGE}/*.ubi; \
	rm -f ${DEPLOY_DIR_IMAGE}/*.ubifs; \
	rm -f ${DEPLOY_DIR_IMAGE}/*.manifest; \
	rm -f ${DEPLOY_DIR_IMAGE}/.ubifs; \
	rm -f ${DEPLOY_DIR_IMAGE}/.manifest; \
	rm -Rf update; \
"

MACHINE_FEATURES += "dvb-c alsa usbhost wlan kernelwifi 3dtv switchoff osdposition hdmicec dvbusb"

require conf/machine/include/mips/tune-mips32.inc
require conf/machine/include/xsarius-wifi.inc
require conf/machine/include/xsarius-dvb-usb.inc
```

## conf/machine/purehdse.conf
```bitbake
#@TYPE: Machine
#@NAME: purehd
#@DESCRIPTION: Machine configuration for the Xsarius purehd

SOC_FAMILY = "bcm73625"
CHIPSET = "bcm73625"

BRAND_OEM = "dags"
MACHINE_BRAND = "XSARIUS"
MACHINE_NAME = "PURE HD SE"

FRIENDLY_FAMILY = "dags73625"
STB_PLATFORM = "dags73625"
MACHINE_MODEL = "dags73625"

KERNEL_FILE = "oe_kernel.bin"
ROOTFS_FILE = "oe_rootfs.bin"
MTD_KERNEL = "mtd2"
MTD_ROOTFS = "mtd0"

MACHINE_FEATURES += " HDMI ci textlcd skins1080"

IMAGEDIR ?= "update/purehdse/cfe"

require conf/machine/include/xsarius.inc
```

## conf/machine/revo4k.conf
```bitbake
#@TYPE: Machine
#@NAME: xsarius revo4k
#@DESCRIPTION: Machine configuration for the revo4k.

SOC_FAMILY = "bcm7439"
CHIPSET = "bcm7439"

BRAND_OEM = "dags"
MACHINE_BRAND = "XSARIUS"
MACHINE_NAME = "REVO 4K"

FRIENDLY_FAMILY = "dags7252"
STB_PLATFORM = "dags7252"
MACHINE_MODEL = "dags7252"

KERNEL_FILE = "oe_kernel.bin"
ROOTFS_FILE = "rootfs.tar.bz2"
MTD_BLACK = "mmcblk0"
MTD_KERNEL = "mmcblk0p1"
MTD_ROOTFS = "mmcblk0p4"

MACHINE_FEATURES += " HDMI RCA ci emmc mmc textlcd dvbproxy dvb-c transcoding streamproxy skins1080"

UPDATE_DIR = "revo4k"

require conf/machine/include/xsarius4k.inc

KV = "linux-3.14-28"
PREFERRED_VERSION_linux-xsarius = "3.14.28"

FORCE_REBOOT_OPTION = "reboot"

MACHINE_KERNEL_PR = "r1"

IMAGE_FSTYPES =+ "ext4"

BBMASK = "meta-vuplus/recipes-graphics/"
BBMASK += "meta-vuplus/recipes-webkit/"
```
